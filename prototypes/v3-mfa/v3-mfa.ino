/**
 * @file v3-mfa.ino
 * @brief MFRC522 is implemented to bring MFA to the access control system.
 *        To access the pin screen, you are shown the scan screen where you must first scan your ID.
 *        All cards share the global pin for this version.
 * @date 2026-08-19
 */

#include <Keypad.h>
#include <Adafruit_GFX.h>
#include <Adafruit_ST7735.h>
#include <SPI.h>
#include <MFRC522.h>

#define SERVO_PIN 21  // define the pwm pin
#define PWM_CHN 0   // define the pwm channel
#define SERVO_FRQ 50  // define the pwm frequency
#define SERVO_BIT 12  // define the pwm precision
#define BUZZER_PIN 18 // define the buzzer pin

#define SPI_SCK 41
#define SPI_MOSI 42
#define SPI_MISO 4

#define TFT_A0 15 // define A0 pin for TFT
#define TFT_RST 16 // define RESET pin for TFT
#define TFT_CS 17 // define CS pin for TFT

#define MFRC522_SDA 7
#define MFRC522_RST 2

#define BLACK 0x0000
#define NAVY 0x000F
#define WHITE 0xFFFF
#define GREEN 0x07E0
#define RED 0xF800

byte rowPins[4] = {11, 12, 13, 14}; // connect to the row pins of the keypad
byte colPins[3] = {8, 9, 10}; // connect to the column pins of the keypad

char keys[4][3] = {
  {'1', '2', '3'},
  {'4', '5', '6'},
  {'7', '8', '9'},
  {'*', '0', '#'}
};

// initialize an instance of class NewKeypad
Keypad myKeypad = Keypad(makeKeymap(keys), rowPins, colPins, 4, 3);

char password[] = {"1234"}; // save the correct password

const String APPROVED_UIDS[] = {"12D8035E"}; // store all approved UIDs via hex

enum SystemState {SCAN_CARD, PIN_ENTRY}; // stores our stages for the authentication process
SystemState currentState = SCAN_CARD;

// moved to global variable as its used in both loop() and resetToScanScreen()
char keyIn[4];
byte keyInNum = 0;

// initialize an instance of class tft
Adafruit_ST7735 tft = Adafruit_ST7735(TFT_CS, TFT_A0, TFT_RST);

// initialize an instance of class mfrc522
MFRC522 mfrc522(MFRC522_SDA, MFRC522_RST);

// image of the scan ID
const unsigned char epd_bitmap_tapIcon [] PROGMEM = {
	0x00, 0x00, 0x00, 0x00, 0x00, 0x00, 0x00, 0x00, 0x00, 0x00, 0x00, 0x00, 0x00, 0x00, 0x00, 0x01, 
	0xff, 0xff, 0xc0, 0x00, 0x00, 0x00, 0x00, 0x00, 0x00, 0x00, 0x00, 0x3f, 0x80, 0x00, 0xfe, 0x00, 
	0x00, 0x00, 0x00, 0x00, 0x00, 0x00, 0x01, 0xe0, 0x00, 0x00, 0x03, 0xe0, 0x00, 0x00, 0x00, 0x00, 
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	0x00, 0x00, 0x00, 0x00
};

void setup() {
  servo_set_pin(SERVO_PIN);
  servo_set_angle(0);
  pinMode(BUZZER_PIN, OUTPUT);

  SPI.begin(SPI_SCK, SPI_MISO, SPI_MOSI, -1);

  tft.initR(INITR_BLACKTAB);
  tft.setRotation(3); // tft display becomes horizontal
  tft.fillScreen(BLACK);

  mfrc522.PCD_Init();
  
  resetToScanScreen(); // prompt with the user to scan their ID
}

void loop() {
  if (currentState == SCAN_CARD) {
    if (!mfrc522.PICC_IsNewCardPresent() || !mfrc522.PICC_ReadCardSerial()) {
      return;
    }
    
    String scannedUID = ""; // current scanned UID

    for (byte i = 0; i < mfrc522.uid.size; i++) {
      if (mfrc522.uid.uidByte[i] < 0x10) { // prepending a 0 before the hex string
        scannedUID += "0";
      }
      scannedUID += String(mfrc522.uid.uidByte[i], HEX);
    }
    scannedUID.toUpperCase();

    bool isApprovedUID = false;

    // using String& for memory efficency on ESP32
    for (const String& uid : APPROVED_UIDS) {
      if (uid == scannedUID) {
        isApprovedUID = true;
      }
    }
    mfrc522.PICC_HaltA();

    if (isApprovedUID) {
      currentState = PIN_ENTRY;
      keyInNum = 0;
      buzzScanned();
      drawPinScreen();
    } else {
      drawAccessDenied();
      resetToScanScreen();
    }
  }

  if (currentState == PIN_ENTRY) {
    char keyPressed = myKeypad.getKey();  // get the character input

    if (keyPressed) {
      if (keyPressed < '0' || keyPressed > '9') {
        if (keyPressed == '*' && keyInNum > 0) { // clear last input
          buzzKeyPress();
          keyInNum--;
          eraseAsterisk(keyInNum);
        }
        if (keyPressed == '#' && keyInNum == 4) { // when '#' is pressed and 4 digits have been entered
          bool isRight = true;

          // check each character of the password if its correct
          for (int i = 0; i < 4; i++) {
            if (keyIn[i] != password[i])
              isRight = false;
          }

          if (isRight) {
            drawAccessGranted();
            resetToScanScreen();
          } else {
            drawAccessDenied();
            resetToScanScreen();
          }
          
          keyInNum = 0;
        }
        return;
      }
      
      if (keyInNum < 4) { // allows a max of 4 digits
        buzzKeyPress();
        drawAsterisk(keyInNum);
        keyIn[keyInNum++] = keyPressed; // save the input characters
      }
    }
  }
}

void servo_set_pin(int pin) {
  ledcAttachChannel(pin, SERVO_FRQ, SERVO_BIT, PWM_CHN);
}

void servo_set_angle(int angle) {
  if (angle > 180 || angle < 0)
    return;
  long pwm_value = map(angle, 0, 180, 103, 512);
  ledcWrite(SERVO_PIN, pwm_value);
}

void buzzKeyPress() {
  tone(BUZZER_PIN, 1800, 30);
}

void buzzGranted() {
  tone(BUZZER_PIN, 1046, 100);
  delay(100);
  tone(BUZZER_PIN, 1318, 100); 
  delay(100);
  tone(BUZZER_PIN, 1568, 150);
  delay(150);
}

void buzzDenied() {
  tone(BUZZER_PIN, 400, 200);
  delay(200);
  tone(BUZZER_PIN, 300, 250);
  delay(250);
}

void buzzScanned() {
  tone(BUZZER_PIN, 2500, 100);
}

void drawHeader(const String title, uint16_t bgColor) {
  tft.fillRect(0, 0, 160, 22, bgColor);
  drawCenterText(title, 80, 7, 1);
  tft.drawFastHLine(0, 22, 160, WHITE);
}

void drawScanScreen() {
  tft.fillScreen(BLACK);
  
  drawHeader("ACCESS CONTROL", NAVY);
  
  tft.drawBitmap(32, 35, epd_bitmap_tapIcon, 96, 55, WHITE);

  drawCenterText("PLEASE SCAN ID", 80, 100, 1);
}

void resetToScanScreen() {
  currentState = SCAN_CARD;
  keyInNum = 0;
  drawScanScreen();
}

void drawPinScreen() {
  tft.fillScreen(BLACK);

  drawHeader("ACCESS CONTROL", NAVY);

  drawCenterText("ENTER YOUR 4 DIGIT PIN", 80, 40, 1);

}

void drawAccessGranted() {
  tft.fillScreen(BLACK);

  drawHeader("ACCESS CONTROL", NAVY);

  // draw a white checkmark in a green circle
  tft.fillCircle(80, 85, 24, GREEN);
  tft.drawLine(68, 85, 76, 93, WHITE);
  tft.drawLine(69, 85, 77, 93, WHITE);
  tft.drawLine(76, 93, 92, 75, WHITE);
  tft.drawLine(77, 93, 93, 75, WHITE);

  drawCenterText("ACCESS GRANTED", 80, 40, 1);
  
  buzzGranted();
  servo_set_angle(90);  // servo opens
  delay(2000);
  servo_set_angle(0); // servo closes
}

void drawAccessDenied() {
  tft.fillScreen(BLACK);

  drawHeader("ACCESS CONTROL", NAVY);

  // draw a white X in a red circle
  tft.fillCircle(80, 85, 24, RED);
  tft.drawLine(68, 73, 92, 97, WHITE);
  tft.drawLine(69, 73, 93, 97, WHITE);
  tft.drawLine(92, 73, 68, 97, WHITE);
  tft.drawLine(93, 73, 69, 97, WHITE);

  drawCenterText("ACCESS DENIED", 80, 40, 1);
  
  buzzDenied();

  delay(2000);
}

void drawCenterText(const String &text, int x, int y, int textSize) {
  int16_t x1, y1;
  uint16_t w, h;

  tft.setTextSize(textSize);
  tft.getTextBounds(text, 0, 0, &x1, &y1, &w, &h); // calculate dimensions at (0,0) by storing offset in x1 and y1, width and height in w and h
  tft.setCursor(x - w / 2, y); // center the text horizontally
  tft.print(text);
}

void drawAsterisk(int index) {
  int x = 68 + (index * 6); // middle of screen is 80px, 4 digits takes up 24px, divide to both sides of the middle will give us the 'x' at an index
  tft.setTextSize(1);
  tft.setCursor(x, 80);
  tft.print("*");
}

void eraseAsterisk(int index) {
  int x = 68 + (index * 6);
  tft.fillRect(x, 80, 6, 8, BLACK);
}